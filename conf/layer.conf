## conf/layer.conf
```bitbake
# We have a conf and classes directory, add to BBPATH
BBPATH .= ":${LAYERDIR}"

BBFILES := "${BBFILES} ${LAYERDIR}/recipes*/*/*.bb ${LAYERDIR}/recipes*/*/*.bbappend"

BBFILE_COLLECTIONS += "crystalfontz"
BBFILE_PATTERN_crystalfontz := "^${LAYERDIR}/"
BBFILE_PRIORITY_crystalfontz = "10"

LICENSE_PATH += "${LAYERDIR}/common/licenses"

LAYERDEPENDS_crystalfontz = "fsl-arm fsl-arm-extra"
```

## conf/machine/cfa-10036.conf
```bitbake
#@TYPE: Machine
#@NAME: Crystalfontz CFA-10036
#@SOC: i.MX28
#@DESCRIPTION: Machine configuration for CFA-10036

include conf/machine/include/mxs-base.inc

SOC_FAMILY = "mxs:mx28"

IMAGE_BOOTLOADER = "barebox"
IMXBOOTLETS_MACHINE = "iMX28_EVK"

KERNEL_IMAGETYPE = "zImage"
KERNEL_DEVICETREE = "${S}/arch/arm/boot/dts/imx28-cfa10036.dts"

SDCARD_ROOTFS ?= "${DEPLOY_DIR_IMAGE}/${IMAGE_NAME}.rootfs.ext3"
IMAGE_FSTYPES ?= "tar.bz2 ext3 sdcard"

SERIAL_CONSOLE = "115200 ttyAMA0"

MACHINE_FEATURES = "apm usbgadget usbhost vfat"
```

## conf/machine/cfa10036.conf
```bitbake
#@TYPE: Machine
#@NAME: Crystalfontz CFA-10036
#@SOC: i.MX28
#@DESCRIPTION: Machine configuration for CFA-10036

include conf/machine/include/mxs-base.inc

SOC_FAMILY = "mxs:mx28"

PREFERRED_PROVIDER_virtual/kernel = "linux-cfa"

BAREBOX_MACHINE = "cfa10036_defconfig"
IMAGE_BOOTLOADER = "barebox"
BAREBOX_BINARY = "barebox"

#can be removed after inclusion in the mainline
IMAGE_CLASSES += "image_types_cfa"

IMXBOOTLETS_MACHINE = "cfa10036"
BOOT_SPACE="32768"

KERNEL_IMAGETYPE = "zImage"
KERNEL_DEVICETREE = "${S}/arch/arm/boot/dts/imx28-cfa10036.dts"
KERNEL_DEVICETREE += "${S}/arch/arm/boot/dts/imx28-cfa10037.dts"
KERNEL_DEVICETREE += "${S}/arch/arm/boot/dts/imx28-cfa10049.dts"
KERNEL_DEVICETREE += "${S}/arch/arm/boot/dts/imx28-cfa10057.dts"
KERNEL_DEVICETREE += "${S}/arch/arm/boot/dts/imx28-cfa10058.dts"

#we need the kernel to be installed in the final image
IMAGE_INSTALL_append = " kernel-image kernel-devicetree"

SDCARD_ROOTFS ?= "${DEPLOY_DIR_IMAGE}/${IMAGE_NAME}.rootfs.ext3"
IMAGE_FSTYPES ?= "tar.bz2 ext3 barebox.sb sdcard"

SERIAL_CONSOLE = "115200 ttyAMA0"

MACHINE_FEATURES = "apm usbgadget usbhost vfat"

# Gstreamer plugin
MACHINE_GSTREAMER_PLUGIN ?= "gst-fsl-plugin"
```

## conf/machine/cfa100xx.conf
```bitbake
#@TYPE: Machine
#@NAME: Crystalfontz CFA-100xx
#@SOC: i.MX28
#@DESCRIPTION: Machine configuration for all cfa boards

include conf/machine/include/cfa10036.inc

KERNEL_DEVICETREE += "imx28-cfa10037.dtb"
KERNEL_DEVICETREE += "imx28-cfa10049.dtb"
KERNEL_DEVICETREE += "imx28-cfa10055.dtb"
KERNEL_DEVICETREE += "imx28-cfa10056.dtb"
KERNEL_DEVICETREE += "imx28-cfa10057.dtb"
KERNEL_DEVICETREE += "imx28-cfa10058.dtb"

MACHINE_FEATURES += "touchscreen"
```
